/* activate bluetooth */
#define CONFIG_WIRELESS 1

#define ZMK_BASE_LAYER(name, LT, RT, LM, RM, LB, RB, LH, RH)                                                         \ 
    ZMK_LAYER(                                                                                                       \
        name,                                                                                                        \
        &kp EQUAL &kp N1 &kp N2 &kp N3 &kp N4 &kp N5 &none       &none &kp N6 &kp N7 &kp N8 &kp N9 &kp N0 &kp MINUS  \
        &kp TAB                                   LT &none       &none RT                                 &kp BSLH   \
        &kp ESC                                   LM &none       &none RM                                 &kp SQT    \
        &kp LSHFT                                 LB                   RB                                 &kp RSHFT  \
        &none &kp GRAVE &kp CAPS &kp LEFT &kp RIGHT &kp LCTRL &kp LALT      &kp LGUI  &kp RCTRL &kp UP &kp DOWN U_WH_D U_WH_U &none      \
    )



#define X_MH    &kp HOME    &kp PG_UP
#define X_RH    &kp END     &kp PG_DN

/* leds and backlights */
#include <dt-bindings/zmk/rgb.h>
#include <dt-bindings/zmk/backlight.h>

#include "zmk-helpers/key-labels/adv360.h"
#include "base.keymap"
