#define CONFIG_WIRELESS 1

/* map Zen's extra keys */
/* to decide: add back &smart_mouse */
#define ZMK_BASE_LAYER(name, LT, RT, LM, RM, LB, RB, LH, RH)                   \
    ZMK_LAYER(                                                                 \
        name,                                                                  \
        &none        LT RT &none                                               \
        &none        LM RM &none                                               \
        &none        LB RB &none                                               \
        &none LH RH &bs_del                                             \
    )

#include "zmk-helpers/key-labels/36.h"
#include "base.keymap"
